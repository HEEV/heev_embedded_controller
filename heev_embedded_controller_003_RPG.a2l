/************************************************
* ASAP2 file
* Generated by Raptor 3/18/2016 7:48:40 PM
* New Eagle, LLC 2012
* Machine: CL-ENS242-01
* User : rgordon
* OS : Microsoft Windows NT 6.1.7601 Service Pack 1
************************************************/ ASAP2_VERSION 1 51
/begin PROJECT heev_embedded_controller_003
/*LongIdentifier (BUILD_UID) */ "fuESQd5NF0alsm47E4bKa"
/begin MODULE heev_embedded_controller
/*Description */ ""
/begin IF_DATA XCP
 /begin PROTOCOL_LAYER /* XCP protocol layer version */ 0x100 /* T1 [ms] */ 2000 /* T2 [ms] */ 2000 /* T3 [ms] */ 2000 /* T4 [ms] */ 2000 /* T5 [ms] */ 2000 /* T6 [ms] */ 0050 /* T7 [ms] */ 0050 /* MAX_CTO */ 8 /* MAX_DTO */ 8 /* BYTE_ORDER */ BYTE_ORDER_MSB_FIRST /* ADDRESS_GRANULARITY */ ADDRESS_GRANULARITY_BYTE OPTIONAL_CMD SET_REQUEST OPTIONAL_CMD SET_MTA OPTIONAL_CMD UPLOAD OPTIONAL_CMD BUILD_CHECKSUM OPTIONAL_CMD TRANSPORT_LAYER_CMD OPTIONAL_CMD CLEAR_DAQ_LIST OPTIONAL_CMD SET_DAQ_PTR OPTIONAL_CMD WRITE_DAQ OPTIONAL_CMD SET_DAQ_LIST_MODE OPTIONAL_CMD START_STOP_DAQ_LIST OPTIONAL_CMD START_STOP_SYNCH OPTIONAL_CMD GET_DAQ_CLOCK OPTIONAL_CMD FREE_DAQ OPTIONAL_CMD ALLOC_DAQ OPTIONAL_CMD ALLOC_ODT OPTIONAL_CMD ALLOC_ODT_ENTRY OPTIONAL_CMD GET_SEED OPTIONAL_CMD UNLOCK OPTIONAL_CMD GET_DAQ_RESOLUTION_INFO OPTIONAL_CMD GET_DAQ_PROCESSOR_INFO OPTIONAL_CMD DOWNLOAD OPTIONAL_CMD GET_COMM_MODE_INFO
  /begin COMMUNICATION_MODE_SUPPORTED /begin BLOCK SLAVE MASTER /* MAX_BS */ 0xff /* MIN_ST */ 100 /end BLOCK /end COMMUNICATION_MODE_SUPPORTED
  SEED_AND_KEY_EXTERNAL_FUNCTION "raptor_XCPSecurity.dll" /end PROTOCOL_LAYER
 /begin DAQ /* DAQ_CONFIG_TYPE */ DYNAMIC /* MAX_DAQ */ 0 /* MAX_EVENT_CHANNEL */ 3 /* MIN_DAQ */ 0 /* OPTIMISATION_TYPE */ OPTIMISATION_TYPE_DEFAULT /* ADDRESS_EXTENSION */ ADDRESS_EXTENSION_DAQ /* IDENTIFICATION_FIELD */ IDENTIFICATION_FIELD_TYPE_ABSOLUTE /* GRANULARITY_ODT_ENTRY_SIZE_DAQ */ GRANULARITY_ODT_ENTRY_SIZE_DAQ_BYTE /* MAX_ODT_ENTRY_SIZE_DAQ */ 0 /* OVERLOAD_INDICATION */ NO_OVERLOAD_INDICATION
  /begin TIMESTAMP_SUPPORTED /* TIMESTAMP_TICKS */ 1 /* TIMESTAMP_SIZE */ SIZE_DWORD /* TIMESTAMP_RESOLUTION */ UNIT_1MS /end TIMESTAMP_SUPPORTED
  /begin EVENT "List_5ms" "List_5ms" 0 DAQ_STIM 0xff 5 6 0 /end EVENT
  /begin EVENT "List_10ms" "List_10ms" 1 DAQ_STIM 0xff 10 6 0 /end EVENT
  /begin EVENT "List_100ms" "List_100ms" 2 DAQ_STIM 0xff 100 6 0 /end EVENT
 /end DAQ
 /begin XCP_ON_CAN /* XCP on CAN 1.0 */ 0x0100 /* auto-detection -- Bit31= 1: EXT */ CAN_ID_BROADCAST 0x100 /* CMD/STIM (master -> slave) -- Bit31= 1: EXT */ CAN_ID_MASTER 0x200 /* RES/ERR/EV/SERV/DAQ (slave -> master) -- Bit31= 1: EXT */ CAN_ID_SLAVE 0x300 /* In Hz */ BAUDRATE 250000 /* Percentage of complete bit time. */ SAMPLE_POINT 75 SAMPLE_RATE SINGLE /* Slots per bit time. */ BTL_CYCLES 0 /* Length of the synch segment. */ SJW 2 /* Sync Edge */ SYNC_EDGE SINGLE /end XCP_ON_CAN
/end IF_DATA
/begin MOD_PAR /* COMMENT */ "" ECU_CALIBRATION_OFFSET 0x00000000 ADDR_EPK 0x2000006F EPK "fuESQd5NF0alsm47E4bKa"
 /begin MEMORY_SEGMENT CODE1 "Interrupt & Reset Vectors, Version Infos, Checksum Info" CODE FLASH INTERN 0x00040000 0x00001100 -1 -1 -1 -1 -1
  /begin IF_DATA XCP
   /begin SEGMENT 0 0x01 0x00 0x00 0x00 /begin CHECKSUM XCP_CRC_16_CITT /end CHECKSUM /end SEGMENT
  /end IF_DATA
 /end MEMORY_SEGMENT
 /begin MEMORY_SEGMENT Application "Application Flash" CODE FLASH INTERN 0x00041100 0x0001EAE0 -1 -1 -1 -1 -1
  /begin IF_DATA XCP
   /begin SEGMENT 1 0x01 0x00 0x00 0x00 /begin CHECKSUM XCP_CRC_16_CITT /end CHECKSUM /end SEGMENT
  /end IF_DATA
 /end MEMORY_SEGMENT
 /begin MEMORY_SEGMENT ConstFLASH "Const FLASH Space" CODE FLASH INTERN 0x20000000 0x00000099 -1 -1 -1 -1 -1
  /begin IF_DATA XCP
   /begin SEGMENT 2 0x01 0x00 0x00 0x00 /begin CHECKSUM XCP_CRC_16_CITT /end CHECKSUM /end SEGMENT
  /end IF_DATA
 /end MEMORY_SEGMENT
 /begin MEMORY_SEGMENT CODE2 "Application Code" CODE FLASH INTERN 0x20000099 0x00002117 -1 -1 -1 -1 -1
  /begin IF_DATA XCP
   /begin SEGMENT 5 0x01 0x00 0x00 0x00 /begin CHECKSUM XCP_CRC_16_CITT /end CHECKSUM /end SEGMENT
  /end IF_DATA
 /end MEMORY_SEGMENT
 /begin MEMORY_SEGMENT MeasurmentRAM "Measurement Space" VARIABLES RAM INTERN 0x40000438 0x00000001 -1 -1 -1 -1 -1
  /begin IF_DATA XCP
   /begin SEGMENT 6 0x01 0x00 0x00 0x00 /begin CHECKSUM XCP_CRC_16_CITT /end CHECKSUM /end SEGMENT
  /end IF_DATA
 /end MEMORY_SEGMENT
 /* 0x00040000 - 0x00041100 : CODE1 */ /* 0x00041100 - 0x0005FBE0 : Application */ /* 0x20000000 - 0x20000099 : ConstFLASH */ /* 0x20000099 - 0x200021B0 : CODE2 */ /* 0x40000438 - 0x40000439 : MeasurmentRAM */ /end MOD_PAR
/begin MOD_COMMON /* COMMENT */ "" BYTE_ORDER MSB_FIRST ALIGNMENT_BYTE 1 ALIGNMENT_FLOAT32_IEEE 1 ALIGNMENT_FLOAT64_IEEE 1 ALIGNMENT_LONG 1 ALIGNMENT_WORD 1 /end MOD_COMMON
/begin RECORD_LAYOUT RECORD_LAYOUT__1 FNC_VALUES 1 UBYTE ROW_DIR DIRECT /end RECORD_LAYOUT
/begin RECORD_LAYOUT RECORD_LAYOUT__2 FNC_VALUES 1 ULONG ROW_DIR DIRECT /end RECORD_LAYOUT
/begin RECORD_LAYOUT RECORD_LAYOUT__3 FNC_VALUES 1 UWORD ROW_DIR DIRECT /end RECORD_LAYOUT
/begin COMPU_METHOD COMPU_METHOD__2 "" /*ConversionType*/ RAT_FUNC /*Format */ "%3.0" /*Unit */ "" /*Coefficients */ COEFFS 0 1 0 0 0 1 /end COMPU_METHOD
/begin COMPU_METHOD COMPU_METHOD__1 "" /*ConversionType*/ RAT_FUNC /*Format */ "%5.0" /*Unit */ "" /*Coefficients */ COEFFS 0 1 0 0 0 1 /end COMPU_METHOD
/begin MEASUREMENT EcuAddr "Ecu Address for the target." ULONG COMPU_METHOD__2 /*Resolution */ 0 /*Accuracy */ 0 0 4294967295 ECU_ADDRESS 0x2000008A /end MEASUREMENT
/begin MEASUREMENT WakeInput "" UBYTE COMPU_METHOD__1 /*Resolution */ 0 /*Accuracy */ 0 0 1 ECU_ADDRESS 0x40000438 /begin FUNCTION_LIST /*FunctionList */ Subsystem /end FUNCTION_LIST /end MEASUREMENT
/begin CHARACTERISTIC BuildNumber "Model build number." VALUE 0x20000018 RECORD_LAYOUT__2 0 COMPU_METHOD__2 0 4294967295 READ_ONLY /end CHARACTERISTIC
/begin CHARACTERISTIC BuildUID "Unique build ID for this software." ASCII 0x2000006F RECORD_LAYOUT__1 0 COMPU_METHOD__2 0 255 READ_ONLY MATRIX_DIM 21 1 1 /end CHARACTERISTIC
/begin CHARACTERISTIC CalIdTxt "Calibration ID for this Software Package." ASCII 0x2000004F RECORD_LAYOUT__1 0 COMPU_METHOD__2 0 255 MATRIX_DIM 32 1 1 /end CHARACTERISTIC
/begin CHARACTERISTIC DateStamp "Date the model was built." ASCII 0x2000008E RECORD_LAYOUT__1 0 COMPU_METHOD__2 0 255 READ_ONLY MATRIX_DIM 11 1 1 /end CHARACTERISTIC
/begin CHARACTERISTIC HardwareType "Hardware type for the target." VALUE 0x20000086 RECORD_LAYOUT__2 0 COMPU_METHOD__2 0 4294967295 READ_ONLY /end CHARACTERISTIC
/begin CHARACTERISTIC IdTableRev "IdTableRev for the model (XCP device ids)." VALUE 0x20000084 RECORD_LAYOUT__3 0 COMPU_METHOD__2 0 65535 READ_ONLY /end CHARACTERISTIC
/begin CHARACTERISTIC MatlabVersion "Matlab version used for build." ASCII 0x2000001C RECORD_LAYOUT__1 0 COMPU_METHOD__2 0 255 READ_ONLY MATRIX_DIM 12 1 1 /end CHARACTERISTIC
/begin CHARACTERISTIC ModelName "Name of model" ASCII 0x20000000 RECORD_LAYOUT__1 0 COMPU_METHOD__2 0 255 READ_ONLY MATRIX_DIM 24 1 1 /end CHARACTERISTIC
/begin CHARACTERISTIC RaptorVersion "Raptor version used for build." ASCII 0x20000028 RECORD_LAYOUT__1 0 COMPU_METHOD__2 0 255 READ_ONLY MATRIX_DIM 11 1 1 /end CHARACTERISTIC
/begin CHARACTERISTIC SwIdTxt "Software name for this build." ASCII 0x20000033 RECORD_LAYOUT__1 0 COMPU_METHOD__2 0 255 READ_ONLY MATRIX_DIM 28 1 1 /end CHARACTERISTIC
/begin FUNCTION heev_embedded_controller "heev_embedded_controller" /begin SUB_FUNCTION /*SubFunction */ Power_Down /end SUB_FUNCTION /end FUNCTION
/begin FUNCTION Power_Down "Power_Down" /begin SUB_FUNCTION /*SubFunction */ Subsystem /end SUB_FUNCTION /end FUNCTION
/begin FUNCTION Subsystem "Subsystem" /end FUNCTION
/begin USER_RIGHTS Access4 /begin REF_GROUP GroupAccess4 /end REF_GROUP /end USER_RIGHTS
/begin USER_RIGHTS Access1 /begin REF_GROUP GroupAccess1 /end REF_GROUP /end USER_RIGHTS
/begin GROUP GroupAccess1 /begin REF_CHARACTERISTIC SwIdTxt CalIdTxt HardwareType DateStamp /end REF_CHARACTERISTIC /begin REF_MEASUREMENT EcuAddr /end REF_MEASUREMENT /end GROUP
/begin GROUP GroupAccess4
 /begin REF_CHARACTERISTIC ModelName BuildNumber MatlabVersion RaptorVersion BuildUID IdTableRev /end REF_CHARACTERISTIC
 /begin REF_MEASUREMENT WakeInput /end REF_MEASUREMENT
/end GROUP
/end MODULE
/end PROJECT
